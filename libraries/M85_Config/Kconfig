## project/Titan_Mini_camera_ceu/Kconfig
```kconfig
mainmenu "RT-Thread Configuration"

config BSP_DIR
    string
    option env="BSP_ROOT"
    default "."

config RTT_DIR
    string
    option env="RTT_ROOT"
    default "rt-thread"

# you can change the RTT_ROOT default "rt-thread"
# example : default "F:/git_repositories/rt-thread"

config PKGS_DIR
    string
    option env="PKGS_ROOT"
    default "packages"

config ENV_DIR
    string
    option env="ENV_ROOT"
    default "/"

config PLATFORM_DIR
    string
    option env="PLATFORM_DIR"
    default "D:/titanboard/TitanBoard/sdk-bsp-ra8p1-titan-board-1.0.0/sdk-bsp-ra8p1-titan-board-1.0.0/project/Titan_display_camera_ceu/platform"

source "$RTT_DIR/Kconfig"
source "$PKGS_DIR/Kconfig"
source "libraries/Kconfig"
source "$RTT_DIR/../libraries/M85_Config/Kconfig"
```
